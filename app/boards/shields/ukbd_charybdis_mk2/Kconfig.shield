## app/boards/shields/ukbd_charybdis_mk2/Kconfig.shield
```kconfig
config SHIELD_UKBD_CHARYBDIS_MK2_LEFT
    def_bool $(shields_list_contains,ukbd_charybdis_mk2_left)

config SHIELD_UKBD_CHARYBDIS_MK2_RIGHT
    def_bool $(shields_list_contains,ukbd_charybdis_mk2_right)
```

## app/boards/shields/ukbd_kinesis/Kconfig.defconfig
```kconfig
if SHIELD_UKBD_KINESIS

config ZMK_KEYBOARD_NAME
    default "ukbd_kinesis"

config ZMK_SPLIT
    default n

endif
```

## app/boards/shields/ukbd_tbkmini/Kconfig.defconfig
```kconfig
if SHIELD_UKBD_TBKMINI_RIGHT
config ZMK_KEYBOARD_NAME
    default "ukbd_tbkmini"
config ZMK_SPLIT_ROLE_CENTRAL
    default y
endif

if SHIELD_UKBD_TBKMINI_LEFT || SHIELD_UKBD_TBKMINI_RIGHT
config ZMK_SPLIT
    default y
endif
```

## app/boards/shields/ukbd_tbkmini/Kconfig.shield
```kconfig
config SHIELD_UKBD_TBKMINI_LEFT
    def_bool $(shields_list_contains,ukbd_tbkmini_left)

config SHIELD_UKBD_TBKMINI_RIGHT
    def_bool $(shields_list_contains,ukbd_tbkmini_right)
```
