## app/boards/shields/tbkmini/Kconfig.defconfig
```kconfig
if SHIELD_TBKMINI_LEFT

config ZMK_KEYBOARD_NAME
    default "TBK Mini"

config ZMK_SPLIT_ROLE_CENTRAL
    default y

endif

if SHIELD_TBKMINI_LEFT || SHIELD_TBKMINI_RIGHT

config ZMK_SPLIT
    default y

if LVGL

config LV_Z_VDB_SIZE
    default 64

config LV_DPI_DEF
    default 148

config LV_Z_BITS_PER_PIXEL
    default 1

choice LV_COLOR_DEPTH
    default LV_COLOR_DEPTH_1
endchoice

endif # LVGL

endif
```
